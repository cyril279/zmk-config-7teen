## config/boards/shields/7teen/Kconfig.defconfig
```kconfig
# Copyright (c) 2020 The ZMK Contributors
# SPDX-License-Identifier: MIT

if SHIELD_7TEEN_D || SHIELD_7TEEN_A

config ZMK_KEYBOARD_NAME
    default "7teen"

config ZMK_USB
    default y

endif
```

## config/boards/shields/7teen/Kconfig.shield
```kconfig
# Copyright (c) 2020 The ZMK Contributors
# SPDX-License-Identifier: MIT

config SHIELD_7TEEN_D
   def_bool $(shields_list_contains,7teen_d)

config SHIELD_7TEEN_A
   def_bool $(shields_list_contains,7teen_a)
```
